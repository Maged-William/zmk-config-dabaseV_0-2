## boards/shields/dabase_v1-1/Kconfig.defconfig
```kconfig
if SHIELD_DABASE_V11_DONGLE

config ZMK_KEYBOARD_NAME
    default "DabaseV2"

config ZMK_SPLIT_ROLE_CENTRAL
    default y

endif

if SHIELD_DABASE_V11_LEFT || SHIELD_DABASE_V11_RIGHT || SHIELD_DABASE_V11_DONGLE

config ZMK_SPLIT
    default y

config ZMK_BLE
    default y

config ZMK_POINTING
	default y

endif
```

## boards/shields/dabase_v2/Kconfig.shield
```kconfig
# Copyright (c) 2020 The ZMK Contributors
# SPDX-License-Identifier: MIT

config SHIELD_DABASE_V2_LEFT
	def_bool $(shields_list_contains,dabase_v2_left)

config SHIELD_DABASE_V2_RIGHT
	def_bool $(shields_list_contains,dabase_v2_right)

config SHIELD_DABASE_V2_DONGLE
	def_bool $(shields_list_contains,dabase_v2_dongle)
```

## config/west.yml
```yaml
manifest:
  remotes:
    # zmk official
    - name: zmkfirmware
      url-base: https://github.com/zmkfirmware
    - name: Maged-William
      url-base: https://github.com/Maged-William
    - name: efogdev
      url-base: https://github.com/efogdev

  projects:
    - name: zmk
      remote: zmkfirmware
      revision: main
      import: app/west.yml
    - name: dabasev02-zmk-module
      remote: Maged-William
      revision: main
    - name: zmk-ec11-ish-driver
      remote: efogdev
      revision: main


self:
  path: config
```
